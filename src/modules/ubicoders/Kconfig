## src/modules/ubicoders/Kconfig
```kconfig
menuconfig MODULES_UBICODERS
	bool "ubicoders"
	default n
	---help---
		Enable support for the ubicoders example module (ubicoders_simple_app)
```

## src/modules/ubicoders_ips_debug/Kconfig
```kconfig
menuconfig MODULES_UBICODERS_IPS_DEBUG
	bool "ubicoders_ips_debug"
	default n
	---help---
		Enable support for ubicoders_ips_debug (echo of vehicle_visual_odometry as the ubicoders_ips_debug topic)
```
